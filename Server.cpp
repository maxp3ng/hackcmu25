#include <Arduino.h>
#include <WiFi.h>
#include <PubSubClient.h>
#include <SPI.h>
#include <U8g2lib.h>

/*
######################
Output declarations
######################
*/

// LED pin assignments
const int rPin5 = 15;
const int gPin4 = 17;
const int rPin4 = 18;
const int gPin3 = 3;
const int rPin3 = 8;
const int gPin2 = 9;
const int rPin2 = 47;
const int gPin1 = 21;
const int rPin1 = 14;
const int gPin0 = 48;

// switch pin
int ledState = 0;

// Using hardware SPI: MOSI=11, SCK=12
// You can pick your own CS/DC/RESET pins as long as they’re free GPIOs
U8G2_SH1122_256X64_F_4W_HW_SPI u8g2(
  U8G2_R2,       // rotation
  /* cs=*/ 5,   // choose a free GPIO for chip select
  /* dc=*/ 13,    // data/command pin
  /* reset=*/ 4  // reset pin
);

static const unsigned char goodWork[] = {0x00,0xe0,0xff,0x0f,0x00,0x00,0x00,0x00,0x00,0x00,0x00,0x00,0x00,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0x00,0x00};
static const unsigned char didUrbest1[] = {0x00,0x00,0x00,0x00,0xfe,0xff,0x00,0x00,0x00,0x00,0x00,0xf8,0x01,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0x08,0x00};
static const unsigned char didUrbest2[] = {0xc0,0x03,0x00,0x00,0x00,0x00,0x00,0x00,0x00,0x00,0x00,0x00,0x00,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0x00,0x00};
static const unsigned char didUrbest3[] = {0x01,0x00,0xc8,0x00,0x20,0x02,0x00,0x08,0x00,0x00,0x44,0x21,0x00,0x01,0x10,0x00,0x10,0x08,0x00,0x08,0x00,0x02,0x00,0x00,0x22,0x00,0x00,0x00,0x00,0x01,0x00,0x00,0x10,0x00};
static const unsigned char palm1[] = {0x00,0x00,0x00,0xfc,0xff,0x0f,0x00,0x00,0x00,0x00,0x00,0x00,0x00,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0x00,0x00};
static const unsigned char palm2[] = {0x40,0x00,0x00,0x00,0x00,0x08,0x00,0x00,0x00,0x00,0x00,0x02,0x18,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0x10,0x00};
static const unsigned char palm3[] = {0x50,0x00,0x01,0x00,0x00,0x04};
static const unsigned char urFried[] = {0x00,0x00,0x00,0x00,0x00,0x00,0x00,0x00,0x00,0x00,0x00,0x00,0x00,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0x00,0x00};

void leds(int n) {
  switch (n) {
    case 0: {
      digitalWrite(gPin0, HIGH);
      analogWrite(gPin1, 255); analogWrite(rPin1, 255);
      analogWrite(gPin2, 255); analogWrite(rPin2, 255);
      analogWrite(gPin3, 255); analogWrite(rPin3, 255);
      analogWrite(rPin4, 255); analogWrite(gPin4, 255);
      digitalWrite(rPin5, HIGH);
      }
      break;
    case 1: {
      digitalWrite(gPin0, LOW);
      analogWrite(gPin1, 255); analogWrite(rPin1, 255);
      analogWrite(gPin2, 255); analogWrite(rPin2, 255);
      analogWrite(gPin3, 255); analogWrite(rPin3, 255);
      analogWrite(rPin4, 255); analogWrite(gPin4, 255);
      digitalWrite(rPin5, HIGH);
      }
      break;
    case 2: {
      digitalWrite(gPin0, LOW);
      analogWrite(rPin1, 255-51); analogWrite(gPin1, 255-204);
      analogWrite(gPin2, 255); analogWrite(rPin2, 255);
      analogWrite(gPin3, 255); analogWrite(rPin3, 255);
      analogWrite(rPin4, 255); analogWrite(gPin4, 255);
      digitalWrite(rPin5, HIGH);
      }
      break;
    case 3: {
      digitalWrite(gPin0, LOW);
      analogWrite(rPin1, 255-51); analogWrite(gPin1, 255-204);
      analogWrite(rPin2, 255-102); analogWrite(gPin2, 255-153);
      analogWrite(gPin3, 255); analogWrite(rPin3, 255);
      analogWrite(rPin4, 255); analogWrite(gPin4, 255);
      digitalWrite(rPin5, HIGH);
      }
      break;
    case 4: {
      digitalWrite(gPin0, LOW);
      analogWrite(rPin1, 255-51); analogWrite(gPin1, 255-204);
      analogWrite(rPin2, 255-102); analogWrite(gPin2, 255-153);
      analogWrite(rPin3, 255-153); analogWrite(gPin3, 255-102);
      analogWrite(gPin4, 255); analogWrite(rPin4, 255);
      digitalWrite(rPin5, HIGH);
      }
      break;
    case 5: {
      digitalWrite(gPin0, LOW);
      analogWrite(rPin1, 255-51); analogWrite(gPin1, 255-204);
      analogWrite(rPin2, 255-102); analogWrite(gPin2, 255-153);
      analogWrite(rPin3, 255-153); analogWrite(gPin3, 255-102);
      analogWrite(rPin4, 255-204); analogWrite(gPin4, 255-51);
      digitalWrite(rPin5, HIGH);
      }
      break;
    case 6: {
      digitalWrite(gPin0, LOW);
      analogWrite(rPin1, 255-51); analogWrite(gPin1, 255-204);
      analogWrite(rPin2, 255-102); analogWrite(gPin2, 255-153);
      analogWrite(rPin3, 255-153); analogWrite(gPin3, 255-102);
      analogWrite(rPin4, 255-204); analogWrite(gPin4, 255-51);
      digitalWrite(rPin5, LOW);
      }
      break;
   }
}

void displayScore(int score) {
  if (score < 0 || score > 100) {return;}

  char sScore[10]; 
  itoa(score, sScore, 10); 

  if (score > 100) {
    u8g2.setFontMode(1);
    u8g2.setBitmapMode(1);
    u8g2.setFont(u8g2_font_profont29_tr);
    u8g2.drawStr(202, 46, sScore);

    u8g2.setFont(u8g2_font_profont11_tr);
    u8g2.drawStr(202, 21, "Score:");
  }
  else {
    u8g2.setFontMode(1);
    u8g2.setBitmapMode(1);
    u8g2.setFont(u8g2_font_profont29_tr);
    u8g2.drawStr(202, 46, sScore);

    u8g2.setFont(u8g2_font_profont11_tr);
    u8g2.drawStr(202, 21, "Score:");
  }

  if (score > 80 && score <= 100){
    u8g2.drawXBM(22, 2, 140, 62, goodWork);
    u8g2.setFont(u8g2_font_timR10_tr);
    u8g2.drawStr(71, 20, "Good!");
  }
  if (score > 60 && score <= 80)
  {
    u8g2.drawXBM(31, 4, 60, 48, didUrbest1);
    u8g2.drawXBM(12, 36, 121, 28, didUrbest2);

    u8g2.setFont(u8g2_font_timR10_tr);
    u8g2.drawStr(99, 28, "Could be better");

    u8g2.drawXBM(43, 22, 14, 17, didUrbest3);
  }
  if (score > 40 && score <= 60) {
    u8g2.drawXBM(26, 2, 81, 61, palm1);

    u8g2.setFont(u8g2_font_timR10_tr);
    u8g2.drawStr(121, 26, "Get off of");

    u8g2.drawStr(122, 40, "the road");

    u8g2.drawXBM(26, 17, 12, 30, palm2);

    u8g2.drawXBM(87, 14, 7, 6, palm3);
  }
  if (score >= 0 && score <= 40) {
    u8g2.drawXBM(4, 1, 177, 60, urFried);

    u8g2.setFont(u8g2_font_timR10_tr);
    u8g2.drawStr(55, 17, "I hope you");

    u8g2.drawStr(68, 35, "have");

    u8g2.drawStr(65, 52, "insurance");
  }
  
}

/*
##########################
Server delcarations
##########################
*/
unsigned int localPort = 1883;
const char *ssid = "shado";
const char *password = "poopypoo";
const char* broker = "64.225.13.23";

WiFiClient espClient;
PubSubClient client(espClient);

void callback(char* topic, byte* payload, unsigned int length) {
  String msg;
  for (int i = 0; i < length; i++) msg += (char)payload[i];
  Serial.print("Message arrived: ");
  Serial.println(msg);

  //alex edit these 
  if (msg == "LED_0") ledState = 0;
  if (msg == "LED_1") ledState = 1;
  if (msg == "LED_2") ledState = 2;
  if (msg == "LED_3") ledState = 3;
  if (msg == "LED_4") ledState = 4;
  if (msg == "LED_5") ledState = 5;
  if (msg == "LED_6") ledState = 6;

 if (msg[0] == 's') {   // use single quotes for a char
    u8g2.clearBuffer();
    int score = msg.substring(1).toInt();  // Arduino String → substring
    displayScore(score);
    u8g2.sendBuffer();
}

}

void reconnect() {
  while (!client.connected()) {
    if (client.connect("ESP32Client")) {
      client.subscribe("esp32/test/cmd");
    } else {
      delay(5000);
    }
  }
}

void setupWifi(){
  WiFi.begin(ssid, password);

  while (WiFi.status() != WL_CONNECTED){
    delay(500); Serial.print(F("."));
  }
  //init
  client.setServer(broker, localPort);
  client.setCallback(callback);
}

/*
#################
Control loop
#################
*/

void setup() {
  Serial.begin(115200);
  delay(500);
    // set the LED pins outputs
  pinMode(rPin5, OUTPUT);
  pinMode(gPin4, OUTPUT);
  pinMode(rPin4, OUTPUT);
  pinMode(gPin3, OUTPUT);
  pinMode(rPin3, OUTPUT);
  pinMode(gPin2, OUTPUT);
  pinMode(rPin2, OUTPUT);
  pinMode(gPin1, OUTPUT);
  pinMode(gPin0, OUTPUT);

  // Initialize the specific SPI bus with the correct pins
  // SCK, MISO, MOSI, SS (Chip Select)
  SPI.begin(12, 13, 11);
  // Begin the display
  u8g2.begin();


  setupWifi();
  leds(0);
 }

void loop() {
  if (!client.connected()) reconnect();
  client.loop();

  Serial.println("[Server running] ");
  Serial.println (WiFi.localIP());
  
  leds(ledState);
}
